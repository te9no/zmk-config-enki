## boards/shields/enki/Kconfig.defconfig
```kconfig
if SHIELD_ENKI

config ZMK_KEYBOARD_NAME
    default "Enki"

config ZMK_BLE
    default y

config ZMK_SPLIT
    default y

config ZMK_SPLIT_ROLE_CENTRAL
    default n

endif # SHIELD_ENKI
```

## boards/shields/enki/Kconfig.shield
```kconfig
config SHIELD_ENKI
    def_bool $(shields_list_contains,ENKI)

config ENKI_BACKLIGHT_BRIGHTNESS_PCT
    int "Enki backlight brightness percent"
    range 0 100
    default 50
    help
      Sets the default PWM duty cycle for the Enki backlight. The value is a
      percentage (0-100) that will be applied during initialization.
```

## config/west.yml
```yaml
manifest:
  remotes:
    - name: zmkfirmware
      url-base: https://github.com/zmkfirmware
    - name: prospector
      url-base: https://github.com/t-ogura
    - name: halfdane
      url-base: https://github.com/halfdane
    - name: ssbb
      url-base: https://github.com/ssbb
    - name: badjeff
      url-base: https://github.com/badjeff
    - name: kot149
      url-base: https://github.com/kot149
  projects:
    - name: zmk
      remote: zmkfirmware
      revision: main
      import: app/west.yml
    - name: prospector-zmk-module
      remote: prospector
      revision: ed55c164a6c44616a0392b3b4d16ea4d4bd67b91
      path: modules/prospector-zmk-module

    - name: zmk-pmw3610-driver
      remote: badjeff
      revision: main

    # Input processors for absolute to relative coordinate conversion
    - name: zmk-input-processors
      remote: halfdane
      revision: main
      path: modules/zmk-input-processors

    # Input gestures for tap-to-click and trackpad gestures
    - name: zmk-input-gestures
      remote: halfdane
      revision: main
      path: modules/zmk-input-gestures

    # Listeners for layer-triggered events
    - name: zmk-listeners
      remote: ssbb
      revision: v1
      path: modules/zmk-listeners

    # Mouse gesture recognition for touch gestures
    - name: zmk-mouse-gesture
      remote: kot149
      revision: v1
      path: modules/zmk-mouse-gesture
  self:
    path: config
```
